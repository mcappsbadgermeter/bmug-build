## conf/bblayers.conf
```bitbake
# POKY_BBLAYERS_CONF_VERSION is increased each time build/conf/bblayers.conf
# changes incompatibly
YOCTOROOT = "${@os.path.abspath(os.path.join(os.path.join("${TOPDIR}", os.pardir),os.pardir))}"

POKY_BBLAYERS_CONF_VERSION = "2"

BBPATH = "${TOPDIR}"
BBFILES ?= ""

BBLAYERS ?= " \
  ${YOCTOROOT}/poky/meta \
  ${YOCTOROOT}/poky/meta-poky \
  ${YOCTOROOT}/poky/meta-yocto-bsp \
  ${YOCTOROOT}/layers/meta-openembedded/meta-oe \
  ${YOCTOROOT}/layers/meta-openembedded/meta-networking \
  ${YOCTOROOT}/layers/meta-openembedded/meta-python \
  ${YOCTOROOT}/layers/meta-openembedded/meta-perl \
  ${YOCTOROOT}/layers/meta-openembedded/meta-gnome \
  ${YOCTOROOT}/layers/meta-openembedded/meta-multimedia \
  ${YOCTOROOT}/layers/meta-toradex-nxp \
  ${YOCTOROOT}/layers/meta-toradex-bsp-common \
  ${YOCTOROOT}/layers/meta-toradex-demos \
  ${YOCTOROOT}/layers/meta-freescale-3rdparty \
  ${YOCTOROOT}/layers/meta-freescale \
  ${YOCTOROOT}/layers/meta-freescale-distro \
  ${YOCTOROOT}/layers/meta-rauc \
  ${YOCTOROOT}/layers/meta-boug \
  ${YOCTOROOT}/layers/meta-security \
  ${YOCTOROOT}/layers/meta-rauc-config \
  ${YOCTOROOT}/layers/meta-bmug-listener-install \
  "
```

## conf/local.conf
```bitbake
SRC_="/src"

# normal image build:
#MACHINE=colibri-imx8x-boug bitbake boug-image-base

# RAUC update build:
#MACHINE=colibri-imx8x-boug bitbake update-bundle

MACHINE ??= "qemuarm64"

DL_DIR ?= "${SRC_}/downloads"
SSTATE_DIR ?= "${SRC_}/sstate-cache"
DISTRO ?= "bougos"
PACKAGE_CLASSES ?= "package_deb"

# remove for PROD
#EXTRA_IMAGE_FEATURES ?= "debug-tweaks"

#
# Additional image features
#
# The following is a list of additional classes to use when building images which
# enable extra features. Some available options which can be included in this variable
# are:
#   - 'buildstats' collect build statistics
#   - 'image-mklibs' to reduce shared library files size for an image
#   - 'image-prelink' in order to prelink the filesystem image
# NOTE: if listing mklibs & prelink both, then make sure mklibs is before prelink
# NOTE: mklibs also needs to be explicitly enabled for a given image, see local.conf.extended
USER_CLASSES ?= "buildstats image-mklibs image-prelink"
PATCHRESOLVE = "noop"
BB_DISKMON_DIRS ??= "\
    STOPTASKS,${TMPDIR},1G,100K \
    STOPTASKS,${DL_DIR},1G,100K \
    STOPTASKS,${SSTATE_DIR},1G,100K \
    STOPTASKS,/tmp,100M,100K \
    ABORT,${TMPDIR},100M,1K \
    ABORT,${DL_DIR},100M,1K \
    ABORT,${SSTATE_DIR},100M,1K \
    ABORT,/tmp,10M,1K"

PACKAGECONFIG_append_pn-qemu-system-native = " sdl"
CONF_VERSION = "1"

MACHINE="colibri-imx8x-boug"
hostname_pn-base-files = "BMUGW-0-117"
```
